#include "TIMER1.h"

//变量定义
u8 gmsec=0;//ms级定义
u8 gsec=22;//秒定义
u8 gmin=6;//分定义
u8 gshi=9;
u8 year=22;
u8 mouth=2;
u8  day=28;
/*******************************************************************************
* 函 数 名       : time0_init
* 函数功能		 : 定时器0中断配置函数，通过设置TH和TL即可确定定时时间
* 输    入       : 无
* 输    出    	 : 无
*******************************************************************************/
void TIMER1_init(void)
{
	TMOD|=0X10;//选择为定时器0模式，工作方式1
	TH1=0XDC;	//给定时器赋初值，定时10ms
	TL1=0X00;	
	ET1=1;//打开定时器1中断允许
	EA=1;//打开总中断
	TR1=0;//关闭定时器		
}

/*******************************************************************************
* 函 数 名       : time0_start
* 函数功能		 : 定时器0打开
* 输    入       : 无
* 输    出    	 : 无
*******************************************************************************/
void Timer1_start(void)
{
	TR1=1;//打开定时器	
}

/*******************************************************************************
* 函 数 名       : time0_stop
* 函数功能		 : 定时器0关闭
* 输    入       : 无
* 输    出    	 : 无
*******************************************************************************/
void Timer1_stop(void)
{
	TR1=0;//关闭定时器
	TH1=0X00;
	TL1=0X00;	
}

void Timer1() interrupt 3 //定时器0中断函数
{
	TH1=0XDC;	//给定时器赋初值，定时10ms
	TL1=0X00;
	gmsec++;//10ms加1次
	if(gmsec==100)//定时1秒
	{
		gmsec=0;
		gsec++;//对秒计数
		if(gsec==60)//到达60秒，即1分钟
		{
			gsec=0;
			gmin++;//对分计数
			if(gmin==60)
			  {gmin=0;
			   gshi++;
			   if(gshi==24) 
				 {	gshi =0;	
							day++;
						if((year%4)==0&&mouth==2&&day>29){day=1;mouth++;}
						else if((year%4)!=0&&mouth==2&&day>28){day=1;mouth++;}
						else	if((mouth==1||mouth==3||mouth==5||mouth==7||mouth==8||mouth==10)&&day>31){day=1;mouth++;}
						else if((mouth==4||mouth==6||mouth==9||mouth==11)&&day>30){day=1;mouth++;}
						else	if(mouth==12&&day>31){mouth=1;day=1;year++;}
						
				}
			}
		}
	}
}
	
				
				
				
				
